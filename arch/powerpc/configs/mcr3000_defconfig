## cmpc885.its
```
/dts-v1/;

/ {
	description = "CMPC885 image";
	#address-cells = <1>;

	images {
		kernel1 {
			description = "CMPC885 kernel";
			data = /incbin/("vmlinux.bin.gz");
			type = "kernel";
			arch = "ppc";
			os = "linux";
			compression = "gzip";
			load = <00000000>;
			entry = <00000000>;
			hash1 {
				algo = "crc32";
			};
			hash2 {
				algo = "sha1";
			};
		};
		fdt1 {
			description = "CMPC885 DTB";
			data = /incbin/("arch/powerpc/boot/dts/saf3000/cmpc885.dtb");
			type = "flat_dt";
			arch = "ppc";
			compression = "none";
			hash1 {
				algo = "crc32";
			};
			hash2 {
				algo = "sha1";
			};
		};
		fdt2 {
			description = "MCR3000_2G DTB";
			data = /incbin/("arch/powerpc/boot/dts/saf3000/mcr3000_2g.dtb");
			type = "flat_dt";
			arch = "ppc";
			compression = "none";
			hash1 {
				algo = "crc32";
			};
			hash2 {
				algo = "sha1";
			};
		};
		fdt3 {
			description = "MIAE DTB";
			data = /incbin/("arch/powerpc/boot/dts/saf3000/miae.dtb");
			type = "flat_dt";
			arch = "ppc";
			compression = "none";
			hash1 {
				algo = "crc32";
			};
			hash2 {
				algo = "sha1";
			};
		};
	};

	configurations {
		default = "cmpc885";
		cmpc885 {
			description = "CMPC885 configuration";
			kernel = "kernel1";
			fdt = "fdt1";
		};
		mcr3k_2g {
			description = "MCR3000_2G configuration";
			kernel = "kernel1";
			fdt = "fdt2";
		};
		miae {
			description = "MIAE configuration";
			kernel = "kernel1";
			fdt = "fdt3";
		};
	};
};
```

## cmpcpro.its
```
/dts-v1/;

/ {
	description = "CMPCPRO image";
	#address-cells = <1>;

	images {
		kernel1 {
			description = "CMPCPRO kernel";
			data = /incbin/("vmlinux.bin.gz");
			type = "kernel";
			arch = "ppc";
			os = "linux";
			compression = "gzip";
			load = <00000000>;
			entry = <00000000>;
			hash1 {
				algo = "crc32";
			};
			hash2 {
				algo = "sha1";
			};
		};
		fdt1 {
			description = "CMPCPRO DTB";
			data = /incbin/("arch/powerpc/boot/dts/saf3000/cmpcpro.dtb");
			type = "flat_dt";
			arch = "ppc";
			compression = "none";
			hash1 {
				algo = "crc32";
			};
			hash2 {
				algo = "sha1";
			};
		};
		fdt2 {
			description = "MCRPRO DTB";
			data = /incbin/("arch/powerpc/boot/dts/saf3000/mcrpro.dtb");
			type = "flat_dt";
			arch = "ppc";
			compression = "none";
			hash1 {
				algo = "crc32";
			};
			hash2 {
				algo = "sha1";
			};
		};
		fdt3 {
			description = "MIAEPRO DTB";
			data = /incbin/("arch/powerpc/boot/dts/saf3000/miaepro.dtb");
			type = "flat_dt";
			arch = "ppc";
			compression = "none";
			hash1 {
				algo = "crc32";
			};
			hash2 {
				algo = "sha1";
			};
		};
	};

	configurations {
		default = "cmpcpro";
		cmpcpro {
			description = "CMPCPRO configuration";
			kernel = "kernel1";
			fdt = "fdt1";
		};
		mcrpro {
			description = "MCRPRO configuration";
			kernel = "kernel1";
			fdt = "fdt2";
		};
		miaepro {
			description = "MIAEPRO configuration";
			kernel = "kernel1";
			fdt = "fdt3";
		};
	};
};
```

## drivers/net/phy/mux/Kconfig
```kconfig
menuconfig PHY_MUX
	tristate "PHY Multiplexing infrastructure"
	depends on PHYLIB
	depends on PHYLINK
	help
	  Some devices can have multiple PHYs and ports attached to the same
	  interface. This option enables the infrastructure necessary to drive
	  the selection of the PHY to use when multiple are attached.

if PHY_MUX

config SIMPLE_PHY_MUX
	tristate "Simple software-controlled PHY multiplexer"
	help
	  Support for the software-driven PHY multiplexer. No dedicated hardware
	  is involved, all PHYs are directly connected to the same network
	  interface.

config GPIO_PHY_MUX
	tristate "Simple software-controlled PHY multiplexer"
	depends on GPIOLIB
	help
	  Support for the GPIO-based PHY multiplexer. One global GPIO is used
	  to drive the port-selection circuitry, thus limiting the max number of
	  driveable ports to 2 per mux.

endif # PHY_MUX
```

## drivers/platform/Kconfig
```kconfig
if X86
source "drivers/platform/x86/Kconfig"
endif
if MCR3000
source "drivers/platform/mcr3000/Kconfig"
endif
if  MOD885
source "drivers/platform/mod885/Kconfig"
endif
```

## drivers/platform/mcr3000/Kconfig
```kconfig
#
# MCR3000 Platform Specific Drivers
#

menuconfig MCR3000_PLATFORM_DEVICES
	bool "MCR3000 Platform Specific Device Drivers"
	default y
	---help---
	  Say Y here to get to see options for device drivers for MCR3000
	  platform.
	  This option alone does not add any kernel code.

	  If you say N, all options in this submenu will be skipped and disabled.

if MCR3000_PLATFORM_DEVICES

config FPGA_LOADER
	tristate "FPGA loader"
	depends on GPIOLIB
	depends on SPI
	depends on OF_GPIO
	default y
	---help---
	  Module de chargement du code FPGA. Permet de charger le uCOR FPGA
	  au demarrage

config MCR3000_CPLD
	bool "CPLD ChipSelect SPI"
	depends on GPIOLIB
	depends on OF_GPIO
	default y
	---help---
	  Driver GPIO pour les ChipSelects SPI

config OPX_GPIO
	bool "GPIO driver for OPx PINs on MPC8xx"
	depends on GPIOLIB
	depends on OF_GPIO
	default y
	---help---
	  Driver GPIO pour les Outputs OPx du MPC8xx

endif
```

## drivers/platform/mod885/Kconfig
```kconfig
#
# MOD885 Platform Specific Drivers
#

menuconfig MOD885_PLATFORM_DEVICES
	bool "MOD885 Platform Specific Device Drivers"
	default y
	---help---
	  Say Y here to get to see options for device drivers for MOD885
	  platform.
	  This option alone does not add any kernel code.

	  If you say N, all options in this submenu will be skipped and disabled.

if MOD885_PLATFORM_DEVICES

config FPGA_LOADER
	tristate "FPGA loader"
	depends on GPIOLIB
	depends on SPI
	depends on OF_GPIO
	default y
	---help---
	  Module de chargement du code FPGA. Permet de charger un FPGA
	  au demarrage
endif
```

## drivers/platform/saf3000/Kconfig
```kconfig
#
# MCR3000 Platform Specific Drivers
#

menuconfig SAF3000_PLATFORM_DEVICES
	bool "SAF3000 Platform Specific Device Drivers"
	default y
	---help---
	  Say Y here to get to see options for device drivers for SAF3000
	  platform.
	  This option alone does not add any kernel code.

	  If you say N, all options in this submenu will be skipped and disabled.

if SAF3000_PLATFORM_DEVICES

config SAF3000_CLASS
	bool

config FPGA_LOADER
	tristate "FPGA loader"
	depends on GPIOLIB
	depends on SPI
	depends on OF_GPIO
	select SAF3000_CLASS
	default y
	---help---
	  Module de chargement du code FPGA. Permet de charger le uCOR FPGA
	  au demarrage

config OPX_GPIO
	bool "GPIO driver for OPx PINs on MPC8xx"
	depends on GPIOLIB
	depends on OF_GPIO
	default y
	---help---
	  Driver GPIO pour les Outputs OPx du MPC8xx

if MCR3000
config MCR3000_CPLD
	bool "CPLD ChipSelect SPI"
	depends on GPIOLIB
	depends on OF_GPIO
	select SAF3000_CLASS
	default y
	---help---
	  Driver GPIO pour les ChipSelects SPI
endif

if MOD885
config FPGAF_INFO
	tristate "Infos FPGAF"
	select SAF3000_CLASS
	select LEDS_CLASS
	default y
	---help---
	  Driver pour recuperer dans /sys les infos FPGA Firmware

config CMPC_CPLD
	tristate "Pilotage CPLD Carte MPC"
	select LEDS_CLASS
	default y
	---help---
	  Driver pour piloter les leds de la MCR 2G
endif
endif
```

## linux/Documentation/devicetree/bindings/net/pef2256.txt
```
* Wan on Infineon pef2256 E1 controller

The pef2256 is a E1/T1/J1 Framer and Line Interface Component for Long- and
Short-Haul Applications.
Its datashhet can be downloaded at
http://www.datasheetcatalog.com/datasheets_pdf/P/E/F/2/PEF2256E.shtml

The FALC®56 framer and line interface component is designed to fulfill all required
interfacing between analog E1 lines and the digital PCM system highway, H.100/H.110
or H-MVIP bus.

Required properties:
- compatible: Should contain "infineon,pef2256"
- reg: Address and length of the register set for the device.
  There should be a single continuous bank.
- interrupts: Should contain the single interrupt used by the component to notify
  special events (error, data received, data transmitted, ...).

Optional properties:

These properties can be defined to adjust the system interface in E1 mode.

The FALC®56 offers a flexible feature for system designers where for transmit and
receive direction different system clocks and system pulses are necessary. The interface
to the receive system highway is realized by two data buses, one for the data RDO and
one for the signaling data RSIG. The receive highway is clocked on pin SCLKR, while
the interface to the transmit system highway is independently clocked on pin SCLKX.
The frequency of these working clocks and the data rate of 2.048/4.096/8.192/16.384
Mbit/s for the receive and transmit system interface is programmable.

- clock-rate:
  Supported values are: 2 (2.048 Mhz), 4 (4.096 Mhz), 8 (8.192 Mhz), 16 (16.384 Mhz).
  8 if not defined.

- data-rate:
  Supported values are: 2 (2.048 Mbit/sec), 4 (4.096 Mbit/sec), 8 (8.192 Mbit/sec), 16
  (16.384 Mbit/sec).
  8 if not defined.

Adjusting the frame begin (time slot 0, bit 0) relative to SYPR/X or XMFS is possible in
the range of 0 to 125 μs. The minimum shift of varying the time slot 0 begin can be
programmed between 1 bit and 1/8 bit depending of the system clocking and data rate,
e.g. with a clocking/data rate of 2.048 MHz shifting is done bit by bit, while running the
FALC®56 with 16.384 MHz and 2.048 Mbit/s data rate it is done by 1/8 bit

- channel-phase: First time slot transmission channel phase.
  Supported values are: 0, 1, 2, 3, 4, 5, 6, 7.
  0 if not defined.

All transmit or receive system interface data and marker are clocked or sampled with the
following active edge :
* Latched with the first falling edge of the selected PCM highway clock.
* Latched with the first rising edge of the selected PCM highway clock.
The behaviour of "transmit" and "receive" signals is inverse.

- rising-edge-sync-pulse: rising edge synchronous pulse.
  Supported values are: "receive", "transmit".
  "transmit" if not defined.

Examples:

	e1-wan@4,2000000 {
		compatible = "infineon,pef2256";
		reg = <4 0x2000000 0xFF>;
		interrupts = <8 1>;
		interrupt-parent = <&PIC>;
		clock-rate = <4>;
		data-rate = <4>;
		channel-phase = <1>;
		rising-edge-sync-pulse = "transmit";
	};
```

## linux/drivers/platform/Kconfig
```kconfig
if X86
source "drivers/platform/x86/Kconfig"
endif
if GOLDFISH
source "drivers/platform/goldfish/Kconfig"
endif

if SAF3000
source "drivers/platform/saf3000/Kconfig"
endif
```

## mcr3000.its
```
/dts-v1/;

/ {
	description = "MCR3000 image";
	#address-cells = <1>;

	images {
		kernel1 {
			description = "MCR3000 kernel";
			data = /incbin/("vmlinux.bin.lzma");
			type = "kernel";
			arch = "ppc";
			os = "linux";
			compression = "lzma";
			load = <00000000>;
			entry = <00000000>;
			hash1 {
				algo = "crc32";
			};
			hash2 {
				algo = "sha1";
			};
		};
		fdt1 {
			description = "MCR3000 DTB";
			data = /incbin/("arch/powerpc/boot/dts/saf3000/mcr3000.dtb");
			type = "flat_dt";
			arch = "ppc";
			compression = "none";
			hash1 {
				algo = "crc32";
			};
			hash2 {
				algo = "sha1";
			};
		};
	};

	configurations {
		default = "mcr3000";
		mcr3000 {
			description = "MCR3000 configuration";
			kernel = "kernel1";
			fdt = "fdt1";
		};
	};
};
```
